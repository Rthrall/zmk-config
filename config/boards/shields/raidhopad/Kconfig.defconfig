## config/boards/shields/raidhopad/Kconfig.defconfig
```kconfig
# Copyright (c) 2021 The ZMK Contributors
# SPDX-License-Identifier: MIT

if SHIELD_RAIDHOPAD

config ZMK_KEYBOARD_NAME
    default "raidhopad"

endif
```

## config/boards/shields/raidhopad/Kconfig.shield
```kconfig
# Copyright (c) 2021 The ZMK Contributors
# SPDX-License-Identifier: MIT

config SHIELD_RAIDHOPAD
    def_bool $(shields_list_contains,raidhopad)
```
